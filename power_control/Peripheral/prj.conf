## CMakeLists.txt
```
#
# Copyright (c) 2018 Nordic Semiconductor
#
# SPDX-License-Identifier: LicenseRef-Nordic-5-Clause
#

#Minimum version of CMake
cmake_minimum_required(VERSION 3.20.0)

#Where to find Zephyr and its build system files
find_package(Zephyr REQUIRED HINTS $ENV{ZEPHYR_BASE})

#Start the CMake project. NONE is a placeholder to replace a custom name for the project
project(NONE)

# NORDIC SDK APP START
target_sources(app PRIVATE
  src/main.c
)

# NORDIC SDK APP END
zephyr_library_include_directories(.)
```

## prj.conf
```kconfig
#Logger module
CONFIG_LOG=y
#Button and LED library
CONFIG_DK_LIBRARY=y
#Bluetooth LE
CONFIG_BT=y
#Peripheral role support
CONFIG_BT_PERIPHERAL=y
#BLE device name
CONFIG_BT_DEVICE_NAME="Nordic_Peripheral"
#Increase stack size for the System Workqueue
CONFIG_SYSTEM_WORKQUEUE_STACK_SIZE=2048
#Increase stack size for the main thread
CONFIG_MAIN_STACK_SIZE=2048

CONFIG_BT_PATH_LOSS_MONITORING=y
```

## src/main.c
```c
#include <sdc_hci_vs.h>
#include <zephyr/bluetooth/addr.h>
#include <zephyr/bluetooth/bluetooth.h>
#include <zephyr/bluetooth/conn.h>
#include <zephyr/bluetooth/gap.h>
#include <zephyr/bluetooth/hci.h>
#include <zephyr/bluetooth/hci_vs.h>
#include <zephyr/bluetooth/uuid.h>
#include <zephyr/kernel.h>
#include <zephyr/logging/log.h>
#include <zephyr/sys/byteorder.h>

#define MIN_ADV_INT 800
#define MAX_ADV_INT 801

/* Advertising parameter for connectable advertising */
static const struct bt_le_adv_param *adv_param =
    BT_LE_ADV_PARAM((BT_LE_ADV_OPT_CONN |
                     BT_LE_ADV_OPT_USE_IDENTITY), /* Connectable advertising and
                                                   * use identity address
                                                   */
                    MIN_ADV_INT, /* Min Advertising Interval 500ms (800*0.625ms) */
                    MAX_ADV_INT, /* Max Advertising Interval 500.625ms (801*0.625ms) */
                    NULL /* Set to NULL for undirected advertising */
    );

LOG_MODULE_REGISTER(Peripheral_Unit,
                    LOG_LEVEL_INF); /* Sets up logging for peripheral module.
                                     * Log level set to info
                                     */

/* Defines for name */
#define DEVICE_NAME CONFIG_BT_DEVICE_NAME
#define DEVICE_NAME_LEN (sizeof(DEVICE_NAME) - 1)

static struct k_work adv_work; /* Structure used to submit work */

/* Advertising data */
static const struct bt_data ad[] = {
    BT_DATA_BYTES(BT_DATA_FLAGS,
                  (BT_LE_AD_GENERAL |
                   BT_LE_AD_NO_BREDR)), /* Discoverable and only support for BLE */
    BT_DATA(BT_DATA_NAME_COMPLETE, DEVICE_NAME,
            DEVICE_NAME_LEN), /* Full name of device */
};

/* Scan response data. Complementary data to the advertising data, if the
 * central wants more information
 */
static const struct bt_data sd[] = {
    /* 16-bytes UUID of the LBS service */
    BT_DATA_BYTES(BT_DATA_UUID128_ALL, /* Type of data being sent */
                  BT_UUID_128_ENCODE( /* The 16-bytes or 128-bit representing
                                       * the UUID LBS service
                                       */
                      0x00001523, 0x1212, 0xefde, 0x1523, 0x785feabcd123)),
};

/* Function to resume advertising after a disconnection */
static void adv_work_handler(struct k_work *work) {
  int err = bt_le_adv_start(adv_param, ad, ARRAY_SIZE(ad), sd, ARRAY_SIZE(sd));
  if (err) {
    printk("Advertising failed to start (err: %d)\n", err);
    return;
  }
  printk("Advertising successfully started\n");
}

/* Function to submit the work item adv_work to the system work queue */
static void advertising_start(void) { k_work_submit(&adv_work); }

/* Function for notifying when a connection is stopped and the resource becomes
 * available again. Reinitiates advertising
 */
static void recycled_cb(void) {
  printk("Connection object available from previous conn. Disconnect is "
         "complete!\n");
  advertising_start();
}

/* Define the callbacks */
BT_CONN_CB_DEFINE(conn_callbacks) = {
    .recycled = recycled_cb,
};

int main(void) {
  int err;

  LOG_INF("Starting the peripheral unit");

  /* Change the random static address */
  bt_addr_le_t addr;
  /* Defining address and buffer location */
  err = bt_addr_le_from_str("FF:EE:DD:CC:BB:AA", "random", &addr);
  if (err < 0) {
    printk("Invalid BT address (err: %d)\n", err);
  }
  /* Setting the address */
  err = bt_id_create(&addr, NULL);
  if (err < 0) {
    printk("Creating new ID failed (err: %d)\n", err);
  }

  /* Initialize bluetooth subsystem */
  err = bt_enable(NULL);
  if (err) {
    LOG_ERR("Bluetooth init failed (err: %d)\n", err);
    return -1;
  }
  LOG_INF("Bluetooth initialized\n");

  /* Start connectable advertising */
  k_work_init(&adv_work, adv_work_handler);
  advertising_start();

  LOG_INF("Advertising successfully started\n");
}
```
